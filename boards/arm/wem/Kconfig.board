## boards/arm/wem/Kconfig.board
```kconfig
# Copyright (c) 2024
# SPDX-License-Identifier: MIT

config BOARD_WEM
	bool "WEM Mouse"
	depends on SOC_SERIES_NRF52X
```

## boards/arm/wem/Kconfig.defconfig
```kconfig
# Electronut Labs Papyr board configuration

# Copyright (c) 2020 The ZMK Contributors
# SPDX-License-Identifier: MIT

if BOARD_NRFMICRO_NRF52840

config BOARD
    default "wem"

if USB_DEVICE_STACK

config USB_NRFX
    default y

endif # USB_DEVICE_STACK

config BT_CTLR
    default BT


endif # BOARD_NRFMICRO_NRF52840
```

## boards/arm/wem/board.yml
```yaml
board:
  #extend: nrfmicro
  variants:
    - name: zmk
      qualifier: nrf52840
```

## boards/arm/wem/wem_defconfig
```kconfig
# Copyright (c) 2024
# SPDX-License-Identifier: MIT

# Enable GPIO
CONFIG_GPIO=y

CONFIG_USE_DT_CODE_PARTITION=y

CONFIG_BUILD_OUTPUT_UF2=y

# Enable USB
CONFIG_USB_DEVICE_STACK=y
CONFIG_USB_DEVICE_MANUFACTURER="WEM"
CONFIG_USB_DEVICE_PRODUCT="WEM Mouse"
CONFIG_USB_DEVICE_VID=0x1209
CONFIG_USB_DEVICE_PID=0x0001

# Enable BLE
CONFIG_ZMK_BLE=y
CONFIG_ZMK_USB=y

# Logging
CONFIG_ZMK_USB_LOGGING=n
```

## config/west.yml
```yaml
manifest:
  defaults:
    revision: v0.3
  remotes:
    - name: zmkfirmware
      url-base: https://github.com/zmkfirmware
    - name: ncs
      url-base: https://github.com/nrfconnect
    # Additional modules containing boards/shields/custom code can be listed here as well
    # See https://docs.zephyrproject.org/3.2.0/develop/west/manifest.html#projects
  projects:
    - name: zmk
      remote: zmkfirmware
      import: app/west.yml
    - name: sdk-nrf
      remote: ncs
      revision: v2.4.0
  self:
    path: config
```
